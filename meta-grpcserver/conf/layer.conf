## meta-grpcserver/conf/layer.conf
```bitbake
# We have a conf and classes directory, add to BBPATH
BBPATH .= ":${LAYERDIR}"

# We have recipes-* directories, add to BBFILES
BBFILES += "${LAYERDIR}/recipes-*/*/*.bb \
            ${LAYERDIR}/recipes-*/*/*.bbappend"

BBFILE_COLLECTIONS += "meta-grpcserver"
BBFILE_PATTERN_meta-grpcserver = "^${LAYERDIR}/"
BBFILE_PRIORITY_meta-grpcserver = "6"

LAYERDEPENDS_meta-grpcserver = "core"
LAYERSERIES_COMPAT_meta-grpcserver = "hardknott"
```
